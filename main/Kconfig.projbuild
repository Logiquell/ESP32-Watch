## main/Kconfig.projbuild
```kconfig
menu "Watch"

    choice WATCH_FACE
        prompt "Watch face"
        default WATCH_FACE_FLIP

        config WATCH_FACE_FLIP
            bool "Vintage flip clock (radium glow)"
        config WATCH_FACE_LCD
            bool "80s digital LCD"
    endchoice

    config WATCH_SCREEN_TIMEOUT_S
        int "Screen off after (seconds without touch)"
        range 3 600
        default 30

    config WATCH_BRIGHTNESS
        int "Screen brightness (%)"
        range 5 100
        default 80

    config WATCH_TIMEZONE
        string "Timezone (POSIX TZ string)"
        default "UTC0"
        help
            POSIX TZ string used for local time, e.g.
              UTC0                              (UTC / Iceland)
              GMT0BST,M3.5.0/1,M10.5.0          (UK)
              CET-1CEST,M3.5.0,M10.5.0/3        (Central Europe)
              EST5EDT,M3.2.0,M11.1.0            (US Eastern)
              PST8PDT,M3.2.0,M11.1.0            (US Pacific)

    config WATCH_NTP_SERVER
        string "NTP server"
        default "pool.ntp.org"

    config WATCH_RESYNC_HOURS
        int "Hours between time syncs"
        range 1 168
        default 6
        help
            Wi-Fi is switched off between syncs to save battery.

endmenu
```
